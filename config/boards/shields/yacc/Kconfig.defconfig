## config/boards/shields/yacc/Kconfig.defconfig
```kconfig
if SHIELD_YACC_LEFT
 
config ZMK_KEYBOARD_NAME
    default "yacc v1.1"
 
config ZMK_SPLIT_ROLE_CENTRAL
    default y
 
endif
 
if SHIELD_YACC_LEFT || SHIELD_YACC_RIGHT
 
config ZMK_SPLIT
    default y
 
endif
```

## config/boards/shields/yacc/Kconfig.shield
```kconfig
config SHIELD_YACC_LEFT
    def_bool $(shields_list_contains,yacc_left)
    select SHIELD_YACC

config SHIELD_YACC_RIGHT
    def_bool $(shields_list_contains,yacc_right)
    select SHIELD_YACC
```
